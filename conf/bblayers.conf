## conf/bblayers.conf
```bitbake
POKY_BBLAYERS_CONF_VERSION = "2"

BBPATH = "${TOPDIR}"

BSPDIR := "${@os.path.abspath(os.path.dirname(d.getVar('FILE', True)) + '/../..')}"

BBFILES ?= ""

BBLAYERS += " \
  ${BSPDIR}/layers/poky/meta \
  ${BSPDIR}/layers/poky/meta-poky \
  ${BSPDIR}/layers/meta-openembedded/meta-oe \
  ${BSPDIR}/layers/meta-openembedded/meta-python \
  ${BSPDIR}/layers/meta-openembedded/meta-multimedia \
  ${BSPDIR}/layers/meta-openembedded/meta-networking \
  ${BSPDIR}/layers/meta-openembedded/meta-webserver \
  ${BSPDIR}/layers/meta-st-stm32mp \
  ${BSPDIR}/layers/meta-st-openstlinux \
  ${BSPDIR}/layers/meta-qt5 \
  ${BSPDIR}/layers/meta-stm32mp-koan \
  "
```
